/*
 * Mediatek's mt6893 SoC device tree source
 *
 * Copyright (C) 2016 MediaTek Inc.
 *
 * This program is free software; you can redistribute it and/or modify
 * it under the terms of the GNU General Public License version 2 as
 * published by the Free Software Foundation.
 *
 * This program is distributed in the hope that it will be useful,
 * but WITHOUT ANY WARRANTY; without even the implied warranty of
 * MERCHANTABILITY or FITNESS FOR A PARTICULAR PURPOSE.
 * See http://www.gnu.org/licenses/gpl-2.0.html for more details.
 */
/dts-v1/;
/plugin/;
#include <dt-bindings/interrupt-controller/irq.h>
#include <dt-bindings/interrupt-controller/arm-gic.h>
#include <dt-bindings/spmi/spmi.h>
#include <dt-bindings/pinctrl/mt6885-pinfunc.h>
//#ifdef OPLUS_FEATURE_CHG_BASIC
#include "oplus/mozi/oplus6893_21015_21217_common.dtsi"
//#endif /*OPLUS_FEATURE_CHG_BASIC*/

//#ifdef OPLUS_FEATURE_AUDIODRIVER
#include "oplus/mozi/oplus6893_21015_audio_extend.dtsi"
//#endif /*OPLUS_FEATURE_CHG_BASIC*/
#include "mediatek/cust_mt6893_touch_1080x2300.dtsi"
#include "mediatek/cust_mt6893_camera_21015_21217_v1.dtsi"
#include <oplus6893_21015_21217_v1/cust.dtsi>

//#ifdef OPLUS_FEATURE_CHG_BASIC
#include "oplus/mozi/cust_mt6893_oplus_charge_mozi_v2.dtsi"
//#endif /*OPLUS_FEATURE_CHG_BASIC*/
/*End of this file, DO NOT ADD ANYTHING HERE*/
